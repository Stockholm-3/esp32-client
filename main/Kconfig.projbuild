## main/Kconfig.projbuild
```kconfig
# put here your custom config value
menu "Example Configuration"
config ESP_WIFI_SSID
    string "WiFi SSID"
    default "myssid"
    help
	SSID (network name) for the example to connect to.

config ESP_WIFI_PASSWORD
    string "WiFi Password"
    default "mypassword"
    help
	WiFi password (WPA or WPA2) for the example to use.
config WS7B_QEMU_SIM
    bool "QEMU simulation mode (skip hardware init)"
    default n
    help
        Skip I2C, IO expander, RGB panel, and touch init.
        Registers a null LVGL flush callback so the app boots
        without real hardware. Enable when running under QEMU.
endmenu
```

## sdkconfig.defaults
```kconfig
CONFIG_IDF_TARGET="esp32-s3"
CONFIG_ESPTOOLPY_FLASHSIZE_16MB=y
CONFIG_SPIRAM=y
CONFIG_SPIRAM_MODE_OCT=y
CONFIG_SPIRAM_SPEED_80M=y
CONFIG_SPIRAM_MALLOC_ALWAYSINTERNAL=16384
CONFIG_ESP_SYSTEM_EVENT_TASK_STACK_SIZE=4096
CONFIG_ESP_MAIN_TASK_STACK_SIZE=8192
CONFIG_SPIRAM_USE_MALLOC=y
CONFIG_LCD_RGB_ISR_IRAM_SAFE=y
CONFIG_SPIRAM_RODATA=y
CONFIG_SPIRAM_FETCH_INSTRUCTIONS=y
CONFIG_LV_TASK_HANDLER_DELAY_MS=1
CONFIG_LV_MEM_SIZE_KILOBYTES=512
CONFIG_LV_DISP_DEF_REFR_PERIOD=16
CONFIG_FREERTOS_HZ=1000
CONFIG_ESP32S3_DATA_CACHE_LINE_64B=y
CONFIG_COMPILER_OPTIMIZATION_PERF=y

CONFIG_PARTITION_TABLE_CUSTOM=y
CONFIG_PARTITION_TABLE_FILENAME="partitions_custom.csv"

CONFIG_LV_COLOR_DEPTH=16

CONFIG_LV_FONT_MONTSERRAT_40=y
CONFIG_LV_FONT_MONTSERRAT_24=y
CONFIG_LV_FONT_MONTSERRAT_22=y
CONFIG_LV_FONT_MONTSERRAT_18=y
CONFIG_LV_FONT_MONTSERRAT_16=y
CONFIG_LV_FONT_MONTSERRAT_14=y
CONFIG_LV_FONT_MONTSERRAT_12=y
```

## simulator/sdkconfig.defaults
```kconfig
CONFIG_IDF_TARGET="linux"

# Linux simulator sdkconfig defaults generous heap for desktop
CONFIG_LV_MEM_SIZE_KILOBYTES=2048
CONFIG_ESP_MAIN_TASK_STACK_SIZE=32768

# Task handler delay
CONFIG_LV_TASK_HANDLER_DELAY_MS=1

# Linux port: use SDL2 backend in esp_lvgl_port
CONFIG_LV_USE_SDL=y


# Disable ESP LCD (hardware)
CONFIG_ESP_LCD_ENABLE=n

# If present (depends on IDF version)
CONFIG_LCD_ENABLE=n

# LVGL: disable hardware display port
CONFIG_LVGL_PORT_DISPLAY=n

# Or switch to simulator backend (preferred)
CONFIG_LVGL_PORT_USE_SDL=y

CONFIG_LV_USE_SDL=y
CONFIG_LV_USE_DISPLAY=y
CONFIG_LVGL_DISPLAY_NONE=y


CONFIG_LV_COLOR_DEPTH=16

CONFIG_LV_FONT_MONTSERRAT_40=y
CONFIG_LV_FONT_MONTSERRAT_24=y
CONFIG_LV_FONT_MONTSERRAT_22=y
CONFIG_LV_FONT_MONTSERRAT_18=y
CONFIG_LV_FONT_MONTSERRAT_16=y
CONFIG_LV_FONT_MONTSERRAT_14=y
CONFIG_LV_FONT_MONTSERRAT_12=y
```
